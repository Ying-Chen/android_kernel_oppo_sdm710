## drivers/input/touchscreen/oplus_touchscreen/Synaptics/S3706/Kconfig
```kconfig
config TOUCHSCREEN_SYNAPTICS_S3706
  bool "TP Synaptics_S3706 IC enable or not for OPPO"
  help
	  say Y to enable driver for Touchpanel using synaptics s3706
```

## drivers/soc/oplus/Kconfig
```kconfig
source "drivers/soc/oplus/oplus_mdmrst/Kconfig"
source "drivers/soc/oplus/oplus_project/Kconfig"
```

## drivers/soc/oplus/oplus_project/Kconfig
```kconfig
# SPDX-License-Identifier: GPL-2.0-only
# Copyright (C) 2018-2020 Oplus. All rights reserved.

config OPLUS_FEATURE_OPROJECT
  tristate "config oplus project info for kernel"
  default n
  help
    define this config to define oplus project

config TARGET_USE_OLDCDT
  tristate "oldcdt enable or not for OPLUS"
  help
    define this config to define oldcdt enable or not
```
